## IMAGE_CONFIG/build/conf/local.conf
```bitbake
MACHINE ?= "raspberrypi4-64"

DL_DIR ?= "/home/isaac/poky/downloads"
SSTATE_DIR ?= "/home/isaac/poky/sstate-cache"
UNINATIVE_DLDIR ?= "${DL_DIR}/uninative"
DISTRO ?= "poky"

INHERIT += "rm_work"

IMAGE_INSTALL:append = " \
    gpio gpio-adapter-python python3-ctypes \
    python3 \
    python3-requests python3-pyserial python3-smbus2 python3-gpiod \
    python3-flask \
    iw \
    wpa-supplicant wpa-supplicant-cli \
    linux-firmware \
    dhcpcd net-tools ethtool \
    openssh \
    nano \
    connect-wifi \
    python3-picamera2 \
    libcamera libcamera-apps python3-libcamera \
    python3-numpy opencv \
    ffmpeg \
    v4l-utils \
    i2c-tools \
    kernel-module-i2c-dev \
    kernel-module-bcm2835-isp kernel-module-bcm2835-unicam kernel-module-ov5647 \
"

# i2c-bcm2835 es built-in → no lo intentes instalar
IMAGE_INSTALL:remove = " kernel-module-i2c-bcm2835 "
BAD_RECOMMENDATIONS += " kernel-module-i2c-bcm2835 "
PACKAGE_EXCLUDE   += " kernel-module-i2c-bcm2835 "

# Autoload de módulos presentes como módulos
KERNEL_MODULE_AUTOLOAD:append = " i2c-dev bcm2835-isp bcm2835-unicam ov5647"

IMAGE_FEATURES += " ssh-server-openssh "
EXTRA_IMAGE_FEATURES += " debug-tweaks "

IMAGE_ROOTFS_SIZE ?= "2200000"
IMAGE_OVERHEAD_FACTOR = "1.0"
IMAGE_ROOTFS_EXTRA_SPACE = "524288"

LICENSE_FLAGS_ACCEPTED += "synaptics-killswitch commercial"

# Escribe líneas reales en config.txt (usar saltos de línea)
RPI_EXTRA_CONFIG:append = "\n dtoverlay=vc4-kms-v3d\n dtoverlay=ov5647\n dtparam=i2c_vc=on\n"

# Pide al kernel que deploee el overlay en /boot/overlays
RPI_KERNEL_DEVICETREE_OVERLAYS:append = " overlays/ov5647.dtbo"

# (Plan B SOLO si no aparece el archivo en el .wic)
# IMAGE_BOOT_FILES:append = " overlays/ov5647.dtbo;overlays/ "

# Evitar choque con receta antigua
BBMASK += ".*/meta-raspberrypi/dynamic-layers/multimedia-layer/recipes-multimedia/libcamera-apps/.*"

CONF_VERSION = "2"
BB_NUMBER_THREADS = "12"

INHERIT:remove = "spdx"
```

## IMAGE_CONFIG/meta-car-autostart/conf/layer.conf
```bitbake
# ==========================================================
# Layer configuration for meta-car-autostart
# ==========================================================

BBPATH .= ":${LAYERDIR}"

BBFILES += "${LAYERDIR}/recipes-*/*/*.bb \
            ${LAYERDIR}/recipes-*/*/*.bbappend"

BBFILE_COLLECTIONS += "meta-car-autostart"
BBFILE_PATTERN_meta-car-autostart = "^${LAYERDIR}/"
BBFILE_PRIORITY_meta-car-autostart = "6"

LAYERDEPENDS_meta-car-autostart = "core"
LAYERSERIES_COMPAT_meta-car-autostart = "scarthgap"

# (opcional, útil para que se puedan resolver rutas de archivos fácilmente)
BBPATH:append = ":${LAYERDIR}/recipes-core/car-init/files"
```

## IMAGE_CONFIG/meta-picamera2/conf/layer.conf
```bitbake
# We have a conf and classes directory, add to BBPATH
BBPATH .= ":${LAYERDIR}"

# We have recipes-* directories, add to BBFILES
BBFILES += "${LAYERDIR}/recipes-*/*/*.bb \
            ${LAYERDIR}/recipes-*/*/*.bbappend"

BBFILE_COLLECTIONS += "meta-picamera2"
BBFILE_PATTERN_meta-picamera2 = "^${LAYERDIR}/"
BBFILE_PRIORITY_meta-picamera2 = "6"

LAYERDEPENDS_meta-picamera2 = "core"
LAYERSERIES_COMPAT_meta-picamera2 = "scarthgap"
```

## build/conf/bblayers.conf
```bitbake
# POKY_BBLAYERS_CONF_VERSION is increased each time build/conf/bblayers.conf
# changes incompatibly
POKY_BBLAYERS_CONF_VERSION = "2"

BBPATH = "${TOPDIR}"
BBFILES ?= ""

BBLAYERS ?= " \
  /home/isaac/poky/meta \
  /home/isaac/poky/meta-poky \
  /home/isaac/poky/meta-yocto-bsp \
  /home/isaac/poky/meta-raspberrypi \
  /home/isaac/poky/meta-openembedded/meta-oe \
  /home/isaac/poky/meta-openembedded/meta-python \
  /home/isaac/poky/meta-openembedded/meta-networking \
  /home/isaac/poky/raspberry-image/meta-connectRasperry-to-internet \
"
```

## build/conf/local.conf
```bitbake
# ===================================================================
#   Machine configuration
# ===================================================================
MACHINE ?= "raspberrypi4-64"

# ===================================================================
#   Downloads and sstate cache directories
# ===================================================================
DL_DIR ?= "/home/isaac/poky/downloads"
SSTATE_DIR ?= "/home/isaac/poky/sstate-cache"
UNINATIVE_DLDIR ?= "${DL_DIR}/uninative"
DISTRO ?= "poky"


# ===================================================================
#   Build optimization
# ===================================================================
INHERIT += "rm_work"

# ===================================================================
#   Packages to include in the image
# ===================================================================
IMAGE_INSTALL:append = " \
    python3 \
    python3-requests python3-pyserial python3-smbus2 python3-gpiod \
    iw \
    python3-flask \
    wpa-supplicant wpa-supplicant-cli \
    linux-firmware\
    dhcpcd net-tools ethtool \
    openssh \
    nano \
    connect-wifi \ 
"


# ===================================================================
#   Image features
# ===================================================================
IMAGE_FEATURES += " ssh-server-openssh "
EXTRA_IMAGE_FEATURES += " debug-tweaks "

# ===================================================================
#   Extra rootfs space (512 MB)
# ===================================================================
IMAGE_ROOTFS_EXTRA_SPACE = "524288"

# ===================================================================
#   Licenses (para Wi-Fi firmware)
# ===================================================================
LICENSE_FLAGS_ACCEPTED += "synaptics-killswitch"

# ===================================================================
#   Version control
# ===================================================================
CONF_VERSION = "2"

BB_NUMBER_THREADS = "12"

INHERIT:remove = "spdx"
```

## meta-connectRasperry-to-internet/conf/layer.conf
```bitbake
# We have a conf and classes directory, add to BBPATH
BBPATH .= ":${LAYERDIR}"

# We have recipes-* directories, add to BBFILES
BBFILES += "${LAYERDIR}/recipes-*/*/*.bb \
            ${LAYERDIR}/recipes-*/*/*.bbappend"

BBFILE_COLLECTIONS += "meta-connectRasperry-to-internet"
BBFILE_PATTERN_meta-connectRasperry-to-internet = "^${LAYERDIR}/"
BBFILE_PRIORITY_meta-connectRasperry-to-internet = "6"

LAYERDEPENDS_meta-connectRasperry-to-internet = "core"
LAYERSERIES_COMPAT_meta-connectRasperry-to-internet = "scarthgap"

FILESEXTRAPATHS:prepend := "${LAYERDIR}/recipes-connectivity/connect-wifi/files:"
```
